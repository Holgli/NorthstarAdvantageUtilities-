;******************************************************************************
;
;  
;  Form2Adv - NortStar Advantage formatting program. 
;             Using the Mini Monitor type in the loader routine and
;             transmit this program to memory over the serial line
;             (SIO in port 1). 
;
;       - uses FORMAT.COM, BDOS, BIOS code of Northstar Graphics CP/M
;
;       This program only runs standalone. Use MLOAD.COM to create.
;
;       Written by Holger Linning
;
;       Rev      Date       Desc
;       1.0     01/30/20    Original 
;
;*****************************************************************************


BIAS    equ     0c000h          ;start of ram after boot 
START   equ     00080h          ;load address of program (+0c000h)
RESTORE equ     000c0h          ;address of commands to restore CP/M environment
BDOS    equ     0df00h          ;start of BDOS 
BIOS    equ     0ed00h          ;start of BIOS

;-----------------------------------------------------------------------------
;  Prepare start of program which has been loaded to 0c080H before. 
;  Loader program was typed in at 0c000h. 
;-----------------------------------------------------------------------------
        org     START   

        ;map memory
        mvi     a,1 
        out     0a0h            ; page 1 to A0 
        mvi     a,2               
        out     0a1h            ; page 2 to A1
        mvi     a,3               
        out     0a2h            ; page 3 to A2

        ;move restore commands, program, zero page, BDOS and BIOS to first memory page
        lxi     d,RESTORE       ;DE = destination of copy 
        lxi     h,RESTORE+BIAS  ;HL = start of copy
        lxi     b,BIOSDataEnd - RESTORE ;count of bytes
        dw      0b0edh          ;LDIR = copy memory

        ;clear parity erros
        mvi     a,3
        out     060h            ;clear parity errors, enable interrupts 
        
        jmp     RESTORE         ;jump to restore CP/M environment

        org     RESTORE         
                                ;restore BDOS and BIOS
        lxi     d,BDOS          ;DE = destination of copy
        lxi     h,BDOSDataStart ;HL = start of copy
        lxi     b,BIOSDataEnd - BDOSDataStart ;count of bytes
        dw      0b0edh          ;LDIR = copy memory

                                ;restore zero page
        lxi     d,00000h        ;DE = destination of copy
        lxi     h,zerostart     ;HL = start of copy
        lxi     b,zeroend - zerostart ;count of bytes
        dw      0b0edh          ;LDIR = copy memory

        jmp     progstart;      ;now jump to start address of TPA

        ;fill space
        ds      progstart - $ + RESTORE
        
        org     0100h   

;-----------------------------------------------------------------------------
;  Pseudo TPA (insert here the HEX codes of your program)
;-----------------------------------------------------------------------------
progstart:
        db      0c3h, 03eh, 001h, 046h, 04fh, 052h, 04dh, 041h, 054h, 020h, 056h, 045h, 052h, 053h, 049h, 04fh 
        db      04eh, 020h, 031h, 02eh, 031h, 020h, 043h, 04fh, 050h, 059h, 052h, 049h, 047h, 048h, 054h, 02ch 
        db      031h, 039h, 038h, 031h, 020h, 04eh, 04fh, 052h, 054h, 048h, 020h, 053h, 054h, 041h, 052h, 020h 
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        db      000h, 000h, 000h, 000h, 000h, 000h, 000h, 000h, 000h, 000h, 000h, 000h, 000h, 000h, 000h, 000h
progend:     equ     $

;-----------------------------------------------------------------------------
;  end of program
;-----------------------------------------------------------------------------

;-----------------------------------------------------------------------------
;  start of zero page 0000h - 00c0h
;-----------------------------------------------------------------------------
zerostart:     equ     $
        db      0c3h, 003h, 0edh, 000h, 000h, 0c3h, 006h, 0dfh, 0c1h, 035h, 00bh, 049h, 0c3h, 006h, 0c0h, 047h
        db      0b9h, 013h, 008h, 000h, 084h, 047h, 065h, 016h, 089h, 020h, 020h, 033h, 075h, 033h, 0c3h, 0f3h
        db      0c3h, 0f3h, 0d2h, 0d6h, 0ebh, 009h, 0ebh, 03dh, 020h, 0e8h, 0c3h, 004h, 002h, 0afh, 0c3h, 00dh
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        db      027h, 000h, 000h, 000h, 0f0h, 000h, 0ffh, 000h, 000h, 000h, 000h, 000h, 000h, 000h, 000h, 000h
zeroend:     equ     $
;-----------------------------------------------------------------------------
;  end of zero page
;-----------------------------------------------------------------------------

;-----------------------------------------------------------------------------
;  start of BDOS / BIOS
;-----------------------------------------------------------------------------
BDOSDataStart:
        db      0e3h, 016h, 000h, 003h, 0fdh, 06eh, 0c3h, 011h, 0dfh, 099h, 0dfh, 0a5h, 0dfh, 0abh, 0dfh, 0b1h
        db      0dfh, 0ebh, 022h, 043h, 0e2h, 0ebh, 07bh, 032h, 0d6h, 0ech, 021h, 000h, 000h, 022h, 045h, 0e2h
        db      039h, 022h, 00fh, 0e2h, 031h, 041h, 0e2h, 0afh, 032h, 0e0h, 0ech, 032h, 0deh, 0ech, 021h, 074h
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        db      000h, 000h, 000h, 000h, 000h, 000h, 000h, 000h, 000h, 000h, 000h, 000h, 000h, 000h, 000h, 000h
BDOSDataEnd     equ     $

BIOSDataStart:
        db      0c3h, 0d9h, 0fah, 0c3h, 05ch, 0f6h, 0c3h, 003h, 0f4h, 0c3h, 006h, 0f4h, 0c3h, 076h, 0f2h, 0c3h
        db      00ch, 0f4h, 0c3h, 00fh, 0f4h, 0c3h, 012h, 0f4h, 0c3h, 05fh, 0f2h, 0c3h, 0dfh, 0f0h, 0c3h, 062h
        db      0f2h, 0c3h, 068h, 0f2h, 0c3h, 06dh, 0f2h, 0c3h, 07eh, 0f2h, 0c3h, 08ch, 0f2h, 0c3h, 015h, 0f4h
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        db      0e5h, 0e5h, 0e5h, 0e5h, 0e5h, 0e5h, 0e5h, 0e5h, 0e5h, 0e5h, 0e5h, 0e5h, 0e5h, 0e5h, 0e5h, 0e5h
BIOSDataEnd     equ     $

        end


